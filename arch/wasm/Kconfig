## arch/wasm/Kconfig
```kconfig
config WASM
	def_bool y
	depends on !BINFMT_ELF && !MMU && !MODULES && !COREDUMP && !SECCOMP && !UPROBES && !COMPAT
	select ARCH_HAS_BINFMT_WASM
	select ARCH_HAS_SYSCALL_WRAPPER
	select ARCH_NO_PREEMPT
	select ARCH_NO_SWAP
	select ARCH_USE_QUEUED_RWLOCKS
	select ARCH_USE_QUEUED_SPINLOCKS
	select BUG
	select FLATMEM
	select GENERIC_CSUM
	select GENERIC_ENTRY
	select GENERIC_HWEIGHT
	select GENERIC_IRQ_INJECTION
	select GENERIC_IRQ_MIGRATION
	select GENERIC_IRQ_SHOW
	select GENERIC_SMP_IDLE_THREAD
	select OF
	select OF_EARLY_FLATTREE
	select PAGE_SIZE_64KB
	select SMP
	select THREAD_INFO_IN_TASK
	select UACCESS_MEMCPY if !MMU
	select USE_PER_CPU_TLS

config CMDLINE
	string "Kernel command string to append"
	default ""

config MMU
	def_bool n

config EARLY_PRINTK
	def_bool y

config SMP
	def_bool y

config NR_CPUS
	int
	default 1 if !SMP
	default 16 if SMP

config HZ
	int
	default 100

config PAGE_SIZE_64KB
	bool

config GENERIC_BUG
	bool

config GENERIC_HWEIGHT
	def_bool y

config GENERIC_CSUM
	def_bool y

config ARCH_DMA_ADDR_T_64BIT
	def_bool 64BIT

config PHYS_ADDR_T_64BIT
	def_bool 64BIT

config 64BIT
	bool "64bit kernel"
	default n

config HIGHMEM
	def_bool n
	select KMAP_LOCAL

config CONSOLE_LOGLEVEL_QUIET
	int "quiet console loglevel (1-15)"
	range 1 15
	default "4"

config LD_IS_WASMLD
	def_bool y

config DEFAULT_MEM_START
	hex
	prompt "PAGE_OFFSET/PHYS_OFFSET" if !MMU
	default 0x00000000
	help
	  This is the base address used for both PAGE_OFFSET and PHYS_OFFSET
	  in noMMU configurations.

	  If unsure, leave the default value here.
```
